#include "fkb.dtsi"

&default_transform {
	col-offset = <3>;
};

&kscan0 {
       col-gpios
            = <&pro_micro 10 GPIO_ACTIVE_HIGH>
            , <&pro_micro 16 GPIO_ACTIVE_HIGH>
            , <&pro_micro 14 GPIO_ACTIVE_HIGH>
            ;
    };
	
&right_encoder {
	status = "okay";
};
