## config/boards/shields/fkb/Kconfig.defconfig
```kconfig
if SHIELD_FKB_LEFT

config ZMK_KEYBOARD_NAME
	default "fkb"

config ZMK_SPLIT_ROLE_CENTRAL
	default y

endif

if SWEEP_PRO_RIGHT

config ZMK_KEYBOARD_NAME
  default "fkb-R"

endif

if SHIELD_FKB_LEFT || SHIELD_FKB_RIGHT

config ZMK_SPLIT
	default y

config ZMK_USB
	default y

endif
```

## config/boards/shields/fkb/Kconfig.shield
```kconfig
config SHIELD_FKB_LEFT NICE_VIEW_ADAPTER NICE_VIEW
    def_bool $(shields_list_contains,fkb_left)

config SHIELD_FKB_RIGHT
    def_bool $(shields_list_contains,fkbd_right)
```
